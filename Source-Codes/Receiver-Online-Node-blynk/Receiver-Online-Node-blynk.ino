/* ---------------------------------- make2explore.com----------------------------------------------------*/
// Project           - Reyax LoRa Module RYLR998 Testing - IoT mini Project - Remote GreenHouse Monitoring
// Created By        - blog@make2explore.com
// Version - 1.0     - Receiver Code
// Last Modified     - 31/05/2022 20:36:00 @admin
// Software          - C/C++, Arduino IDE, ESP8266 SDK, Libraries
// Hardware          - NodeMCU ESP8266, Reyax LoRa RYLR998 Module,0.96 OLED Display             
// Sensors Used      - NA
// Source Repo       - github.com/make2explore
/* -------------------------------------------------------------------------------------------------------*/

// LoRa Module Configurations Reciever Node
String lora_band = "865000000";     // Enter LoRa band as per your country
String lora_networkid = "7";        // Enter Lora Network ID - Must be same for Tx and Rx Nodes
String lora_TX_address = "621";     // Enter Lora RX address

// Replace with your Blynk Cloud credentials
#define BLYNK_TEMPLATE_ID "xxxxxxxxxxxxxx"
#define BLYNK_DEVICE_NAME "xxxxxxxxxxxxxx"
#define BLYNK_AUTH_TOKEN "xxxxxxxxxxxxxxxxxxxxx"

#define BLYNK_PRINT Serial          // include Blynk libraries
#include <ESP8266WiFi.h> 
#include <BlynkSimpleEsp8266.h>     // include Blynk libraries

#include <Wire.h>
#include <Adafruit_GFX.h>           // include Adafruit Graphics library
#include <Adafruit_SSD1306.h>       // include OLED Display library
#include <SoftwareSerial.h>         // include Software Serial library

// Replace with your network credentials
char auth[] = BLYNK_AUTH_TOKEN;
char ssid[] = "xxxxxxx";  // type your wifi name
char pass[] = "xxxxxxx";  // type your wifi password

BlynkTimer timer;                   // Define Blynk timer object

const byte rxPin = D7;              // Software Serial Pins Rx and Tx
const byte txPin = D8;

// Set up a new SoftwareSerial object
SoftwareSerial loraReceive (rxPin, txPin);

#define SCREEN_WIDTH 128
#define SCREEN_HEIGHT 64

Adafruit_SSD1306 display(SCREEN_WIDTH, SCREEN_HEIGHT, &Wire, -1);

// make2explore Logo Bitmap byte array
static const uint8_t image_data_096OLEDscreens[1024] = {
    0x00, 0x00, 0x00, 0x00, 0x00, 0x00, 0x00, 0x00, 0x00, 0x00, 0x00, 0x00, 0x00, 0x00, 0x00, 0x00, 
    0x00, 0x00, 0x00, 0x00, 0x00, 0x00, 0x00, 0x00, 0x00, 0x00, 0x00, 0x00, 0x00, 0x00, 0x00, 0x00, 
    0x00, 0x00, 0x00, 0x00, 0x00, 0x00, 0x00, 0x00, 0x00, 0x00, 0x00, 0x00, 0x00, 0x00, 0x00, 0x00, 
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    0x00, 0x00, 0x00, 0x00, 0x00, 0x00, 0x00, 0x00, 0x00, 0x00, 0x00, 0x00, 0x00, 0x00, 0x00, 0x00
};

String temperature, humidity, moisture, Pump_Status;

void setup() {
  Serial.begin(9600);
  // Set the baud rate for the SoftwareSerial object
  loraReceive.begin(115200);
  Blynk.begin(auth, ssid, pass);
  
  timer.setInterval(2000L, sendToCloud);
  delay(1000);

  // Configure LoRa module at Startup
  loraReceive.println("AT+BAND=" + lora_band);
  delay(1000);
  loraReceive.println("AT+ADDRESS=" + lora_RX_address);
  delay(1000);
  loraReceive.println("AT+NETWORKID=" + lora_networkid);
  delay(1000);

  
  if(!display.begin(SSD1306_SWITCHCAPVCC, 0x3C)) {
    Serial.println(F("SSD1306 allocation failed"));
    for(;;);
  }
  delay(2000); // Pause for 2 seconds

 
  // Clear the buffer.
  display.clearDisplay();
  
  // Draw bitmap on the screen
  display.drawBitmap(0, 0, image_data_096OLEDscreens, 128, 64, 1);
  
  display.setTextSize(1);
  display.setTextColor(WHITE);
  display.setCursor(20, 56);
  // Display static text
  display.println("make2explore.com");
  display.display();
  delay(2000);
}

//====================== Function to Check Incomming Serial Data ====================================//
void checkSerial(){
  while (loraReceive.available() > 0) {
    // get the new byte:
    String inString = loraReceive.readString();     
    Serial.print("Received Data : ");
    Serial.println(inString); 
    // Data receiving format : +RCV=<Address>,<Length>,<Data>,<RSSI>,<SNR>
    // Example: +RCV=50,5,HELLO,-99,40
    //                | |   |    |   |
    //                0 1   2    3   4
    // So to get DHT22 data : String DataIn = getValue(inString, ',', 2);
    String DataIn = getValue(inString, ',', 2);     //--> data
    
    temperature = getValue(DataIn, '%', 0); //--> Get temperature data
    humidity = getValue(DataIn, '%', 1); //--> Get humidity data
    moisture = getValue(DataIn, '%', 2); //--> Get moisture data
    Pump_Status = getValue(DataIn, '%', 3); //--> Get moisture data

    displayData();

    /*Serial.print("Temperature = ");
    Serial.print(temperature);
    Serial.println(F(" °C"));

    Serial.print("Humidity = ");
    Serial.print(humidity);
    Serial.println(F(" % Rh"));

    Serial.print("Soil Moisture = ");
    Serial.print(moisture);
    Serial.println(F(" %"));

    Serial.print("Pump Status = ");
    Serial.print(Pump_Status);*/
  }  
}

//====================== Function For Sending Recieved data to Blynk Cloud ==========================//
void sendToCloud(){
  Blynk.virtualWrite(V0, temperature);
  Blynk.virtualWrite(V1, humidity);
  Blynk.virtualWrite(V2, moisture);
  
  if(Pump_Status == "Pump_ON"){
    Blynk.virtualWrite(V3, HIGH);
  }else{
    Blynk.virtualWrite(V3, LOW);
  }  
}


//====================== Function to Disply the Data on OLED ======================================//
void displayData(){
  display.clearDisplay();
  display.drawRect(0, 0, 126, 62, WHITE);
  display.setCursor(6,5);
  
  display.setTextSize(1);
  display.setTextColor(WHITE);
  display.setCursor(5,5);
  display.print("Temp = ");
  
  display.setTextSize(1);
  display.setCursor(55,5);
  display.print(temperature);
  
  display.setCursor(104,5);
  display.setTextSize(1);
  display.cp437(true);
  display.write(167);
  display.setTextSize(1);
  display.setCursor(112,5);
  display.print("C");
  
  display.setTextSize(1);
  display.setTextColor(WHITE);
  display.setCursor(5,21);
  display.print("Humi = ");
  
  display.setCursor(55,21);
  display.setTextSize(1);
  display.print(humidity);
  
  display.setCursor(112,21);
  display.print("%");

  display.setCursor(5,37);
  display.setTextSize(1);
  display.print("Mois = ");

  display.setCursor(55,37);
  display.setTextSize(1);
  display.print(moisture);

  display.setCursor(112,37);
  display.print("%");  

  display.setCursor(5,53);
  display.setTextSize(1);
  display.print("Pump = ");

  display.setCursor(55,53);
  display.setTextSize(1);
  display.print(Pump_Status);  
   
  display.display();
  delay(250);   
}


//====================== Function for parsing the incomming data String ======================================//
String getValue(String data, char separator, int index)
{
    int found = 0;
    int strIndex[] = { 0, -1 };
    int maxIndex = data.length() - 1;
 
    for (int i = 0; i <= maxIndex && found <= index; i++) {
        if (data.charAt(i) == separator || i == maxIndex) {
            found++;
            strIndex[0] = strIndex[1] + 1;
            strIndex[1] = (i == maxIndex) ? i+1 : i;
        }
    }
    return found > index ? data.substring(strIndex[0], strIndex[1]) : "";
}

//======================== Main Loop Function  ======================================//
void loop() {
  Blynk.run();
  timer.run(); // Initiates BlynkTimer
  checkSerial();
}

/*========================================= info@make2explore.com ===============================================================*/
